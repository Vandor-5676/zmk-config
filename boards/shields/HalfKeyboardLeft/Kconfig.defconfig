## boards/shields/HalfKeyboardLeft/Kconfig.defconfig
```kconfig
if SHIELD_HalfKeyboardLeft

config ZMK_KEYBOARD_NAME
    default "HalfKeyboardLeft"

endif # SHIELD_HalfKeyboardLeft
```

## boards/shields/HalfKeyboardLeft/Kconfig.shield
```kconfig
config SHIELD_HalfKeyboardLeft
    def_bool $(shields_list_contains,HalfKeyboardLeft)
```
